## config/boards/shields/keyball_nano/dts/bindings/zmk,behavior-pmw-timeout.yaml
```yaml
description: PMW3610 Auto Mouse Timeout Control Behavior
compatible: "zmk,behavior-pmw-timeout"
properties:
  "#binding-cells":
    type: int
    const: 0
  label:
    type: string
    description: Human readable label
  timeout-ms:
    type: int
    required: true
    description: timeout in milliseconds
```

## config/dts/bindings/behavior/zmk,behavior-pmw3610-automouse-timeout.yaml
```yaml
# Copyright (c) 2025 ZMK Contributors
# SPDX-License-Identifier: MIT

description: |
  Behavior for adjusting PMW3610 automouse layer timeout at runtime.
  
  This behavior allows dynamic adjustment of how long the automouse layer
  stays active after trackball movement without recompiling firmware.
  
  Parameter values:
    - Positive number: Set absolute timeout in milliseconds
    - 0: Query current value (no change)
    - -1: Decrease timeout by step
    - -2: Increase timeout by step
    - -3: Reset to default from Kconfig

compatible: "zmk,behavior-pmw3610-automouse-timeout"

include: base.yaml

properties:
  label:
    type: string
    description: Human-readable name for the behavior

  min-timeout-ms:
    type: int
    default: 100
    description: Minimum allowed timeout value in milliseconds

  max-timeout-ms:
    type: int
    default: 5000
    description: Maximum allowed timeout value in milliseconds

  step-ms:
    type: int
    default: 100
    description: Step size for increment/decrement operations in milliseconds

  "#binding-cells":
    const: 1
```

## config/west.yml
```yaml
manifest:
  remotes:
    - name: zmkfirmware
      url-base: https://github.com/zmkfirmware
    - name: tangbonze
      url-base: https://github.com/tangbonze
    - name: dangnm
      url-base: https://github.com/dangnm
  projects:
    - name: zmk
      remote: zmkfirmware
      revision: v0.3
      import: app/west.yml
    - name: zmk-pmw3610-driver
      remote: dangnm
      revision: auto_mouse_timeout_runtime
  self:
    path: config
```
